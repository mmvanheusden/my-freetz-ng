## Backups/freetz-ng/make/libs/cairo/Config.in
```kconfig
config FREETZ_LIB_libcairo
	bool "Cairo (libcairo.so)"
	select FREETZ_LIB_libpixman_1
	select FREETZ_LIB_libfontconfig
	select FREETZ_LIB_libfreetype
	select FREETZ_LIB_libpng16
	select FREETZ_LIB_libz
	default n
	help
		Cairo is a 2D graphics library with support for multiple output devices.
		Cairo is designed to produce consistent output on all output media while
		taking advantage of display hardware acceleration when available.
```

## Backups/freetz-ng/make/libs/fribidi/Config.in
```kconfig
config FREETZ_LIB_libfribidi
	bool "FriBidi (libfribidi.so)"
	default n
	help
		The Free Implementation of the Unicode Bidirectional Algorithm.
```

## Backups/freetz-ng/make/libs/gettext/Config.in
```kconfig
config FREETZ_LIB_libintl
	bool "gettext (libintl.so)"
	select FREETZ_LIB_libiconv if FREETZ_TARGET_UCLIBC_0_9_28
	default n
	help
		GNU Internationalization library
```

## Backups/freetz-ng/make/libs/libdeflate/Config.in
```kconfig
config FREETZ_LIB_libdeflate
	bool "libdeflate (libdeflate.so)"
	default n
	help
		Heavily optimized library for DEFLATE/zlib/gzip compression and decompression
```

## Backups/freetz-ng/make/libs/mbedtls/Config.in
```kconfig
config FREETZ_LIB_libmbedcrypto
	bool "mbedCrypto (libmbedcrypto.so)"
	default n

	config FREETZ_LIB_libmbedcrypto_WITH_BLOWFISH
		bool "With Blowfish cipher" if FREETZ_LIB_libmbedcrypto
		default n
		help
			Enables support for the Blowfish block cipher.

	config FREETZ_LIB_libmbedcrypto_WITH_GENRSA
		bool "With RSA prime-number generation" if FREETZ_LIB_libmbedcrypto
		default n
		help
			Enables the RSA prime-number generation code.

config FREETZ_LIB_libmbedtls
	bool "mbedTLS (libmbedtls.so)"
	default n

config FREETZ_LIB_libmbedx509
	bool "mbedX.509 (libmbedx509.so)"
	default n

choice
	prompt "mbedTLS version"
	default FREETZ_MBEDTLS_VERSION_CURRENT
	default FREETZ_MBEDTLS_VERSION_ABANDON

	config FREETZ_MBEDTLS_VERSION_ABANDON
		bool "2.7 - DEPRECATED"
		depends on  FREETZ_TARGET_GCC_4_MAX

	config FREETZ_MBEDTLS_VERSION_CURRENT
		bool "2.28"
		depends on !FREETZ_TARGET_GCC_4_MAX

endchoice # "mbedTLS version"
```

## Backups/freetz-ng/make/libs/neon/Config.in
```kconfig
config FREETZ_LIB_libneon
	bool "libneon (libneon.so)"
	select FREETZ_LIB_libexpat
	default n
	help
		neon is an HTTP and WebDAV client library, with a C language API.

if FREETZ_LIB_libneon

	choice
		prompt "Version"
			default FREETZ_LIB_libneon_VERSION_CURRENT

		config FREETZ_LIB_libneon_VERSION_ABANDON
			bool "0.30.2"
			depends on FREETZ_KERNEL_VERSION_2_MAX

		config FREETZ_LIB_libneon_VERSION_CURRENT
			bool "0.32.5"
			depends on !FREETZ_KERNEL_VERSION_2_MAX

	endchoice

	config FREETZ_LIB_libneon_WITH_SSL
		bool "build with SSL support"
		select FREETZ_LIB_libcrypto
		select FREETZ_LIB_libssl
		default n
		help
			This option enables SSL support for neon.

	config FREETZ_LIB_libneon_WITH_ZLIB
		bool "build with zlib support"
		select FREETZ_LIB_libz
		default n
		help
			This option enables zlib support for neon.

endif # FREETZ_LIB_libneon
```

## Backups/freetz-ng/make/libs/openjp2/Config.in
```kconfig
config FREETZ_LIB_libopenjp2
	bool "libopenjp2 (libopenjp2.so)"
	default n
	help
		OpenJPEG is an open-source JPEG 2000 codec written in C language.
		It has been developed in order to promote the use of JPEG 2000, a
		still-image compression standard from the Joint Photographic
		Experts Group (JPEG). Since April 2015, it is officially recognized
		by ISO/IEC and ITU-T as a JPEG 2000 Reference Software.
```

## Backups/freetz-ng/make/libs/pango/Config.in
```kconfig
config FREETZ_LIB_libpango_1
	bool "Pango (libpango-1.0.so)"
	select FREETZ_LIB_libglib_2
	select FREETZ_LIB_libgio_2
	select FREETZ_LIB_libgobject_2
	select FREETZ_LIB_libharfbuzz
	select FREETZ_LIB_libfribidi
	default n
	help
		Pango is a library for layout and rendering of text, with an emphasis
		on internationalization. Pango can be used anywhere that text layout
		is needed; however, most of the work on Pango so far has been done using
		the GTK widget toolkit as a test platform. Pango forms the core of text
		and font handling for GTK.

config FREETZ_LIB_libpangoft2_1
	bool "PangoFT2 (libpangoft2-1.0.so)"
	select FREETZ_LIB_libpango_1
	select FREETZ_LIB_libglib_2
	select FREETZ_LIB_libgio_2
	select FREETZ_LIB_libgobject_2
	select FREETZ_LIB_libharfbuzz
	select FREETZ_LIB_libfontconfig
	select FREETZ_LIB_libfreetype
	default n
	help
		Pango is a library for layout and rendering of text, with an emphasis
		on internationalization. Pango can be used anywhere that text layout
		is needed; however, most of the work on Pango so far has been done using
		the GTK widget toolkit as a test platform. Pango forms the core of text
		and font handling for GTK.

config FREETZ_LIB_libpangocairo_1
	bool "PangoCairo (libpangocairo-1.0.so)"
	select FREETZ_LIB_libpango_1
	select FREETZ_LIB_libpangoft2_1
	select FREETZ_LIB_libglib_2
	select FREETZ_LIB_libgio_2
	select FREETZ_LIB_libgobject_2
	select FREETZ_LIB_libharfbuzz
	select FREETZ_LIB_libfribidi
	default n
	help
		Pango is a library for layout and rendering of text, with an emphasis
		on internationalization. Pango can be used anywhere that text layout
		is needed; however, most of the work on Pango so far has been done using
		the GTK widget toolkit as a test platform. Pango forms the core of text
		and font handling for GTK.
```

## Backups/freetz-ng/make/libs/pixman/Config.in
```kconfig
config FREETZ_LIB_libpixman_1
	bool "Pixman (libpixman-1.so)"
	default n
	help
		Pixman is a low-level software library for pixel manipulation, providing
		features such as image compositing and trapezoid rasterization.
```

## Backups/freetz-ng/make/pkgs/bftpd/Config.in
```kconfig
config FREETZ_PACKAGE_BFTPD
	bool "Bftpd 6.1"
	default n
	help
		Small FTP Server

if FREETZ_PACKAGE_BFTPD

	config FREETZ_PACKAGE_BFTPD_WITH_ZLIB
		bool "With on-the-fly compression"
		select FREETZ_LIB_libz
		default n

endif # FREETZ_PACKAGE_BFTPD
```

## Backups/freetz-ng/make/pkgs/dejavu-fonts-ttf/Config.in
```kconfig
menuconfig FREETZ_PACKAGE_DEJAVU_FONTS_TTF
	bool "DejaVu Fonts TTF 2.37 (binary only)"
	default n
	help
		The DejaVu fonts are a font family based on the Vera Fonts. Its purpose
		is to provide a wider range of characters while maintaining the original
		look and feel through the process of collaborative development

if FREETZ_PACKAGE_DEJAVU_FONTS_TTF

	config FREETZ_PACKAGE_DEJAVU_FONTS_TTF_DejaVuMathTeXGyre
		bool "DejaVuMathTeXGyre"
		default n

	config FREETZ_PACKAGE_DEJAVU_FONTS_TTF_DejaVuSans_BoldOblique
		bool "DejaVuSans-BoldOblique"
		default n

	config FREETZ_PACKAGE_DEJAVU_FONTS_TTF_DejaVuSans_Bold
		bool "DejaVuSans-Bold"
		default n

	config FREETZ_PACKAGE_DEJAVU_FONTS_TTF_DejaVuSansCondensed_BoldOblique
		bool "DejaVuSansCondensed-BoldOblique"
		default n

	config FREETZ_PACKAGE_DEJAVU_FONTS_TTF_DejaVuSansCondensed_Bold
		bool "DejaVuSansCondensed-Bold"
		default n

	config FREETZ_PACKAGE_DEJAVU_FONTS_TTF_DejaVuSansCondensed_Oblique
		bool "DejaVuSansCondensed-Oblique"
		default n

	config FREETZ_PACKAGE_DEJAVU_FONTS_TTF_DejaVuSansCondensed
		bool "DejaVuSansCondensed"
		default n

	config FREETZ_PACKAGE_DEJAVU_FONTS_TTF_DejaVuSans_ExtraLight
		bool "DejaVuSans-ExtraLight"
		default n

	config FREETZ_PACKAGE_DEJAVU_FONTS_TTF_DejaVuSansMono_BoldOblique
		bool "DejaVuSansMono-BoldOblique"
		default n

	config FREETZ_PACKAGE_DEJAVU_FONTS_TTF_DejaVuSansMono_Bold
		bool "DejaVuSansMono-Bold"
		default n

	config FREETZ_PACKAGE_DEJAVU_FONTS_TTF_DejaVuSansMono_Oblique
		bool "DejaVuSansMono-Oblique"
		default n

	config FREETZ_PACKAGE_DEJAVU_FONTS_TTF_DejaVuSansMono
		bool "DejaVuSansMono"
		default y

	config FREETZ_PACKAGE_DEJAVU_FONTS_TTF_DejaVuSans_Oblique
		bool "DejaVuSans-Oblique"
		default n

	config FREETZ_PACKAGE_DEJAVU_FONTS_TTF_DejaVuSans
		bool "DejaVuSans"
		default n

	config FREETZ_PACKAGE_DEJAVU_FONTS_TTF_DejaVuSerif_BoldItalic
		bool "DejaVuSerif-BoldItalic"
		default n

	config FREETZ_PACKAGE_DEJAVU_FONTS_TTF_DejaVuSerif_Bold
		bool "DejaVuSerif-Bold"
		default n

	config FREETZ_PACKAGE_DEJAVU_FONTS_TTF_DejaVuSerifCondensed_BoldItalic
		bool "DejaVuSerifCondensed-BoldItalic"
		default n

	config FREETZ_PACKAGE_DEJAVU_FONTS_TTF_DejaVuSerifCondensed_Bold
		bool "DejaVuSerifCondensed-Bold"
		default n

	config FREETZ_PACKAGE_DEJAVU_FONTS_TTF_DejaVuSerifCondensed_Italic
		bool "DejaVuSerifCondensed-Italic"
		default n

	config FREETZ_PACKAGE_DEJAVU_FONTS_TTF_DejaVuSerifCondensed
		bool "DejaVuSerifCondensed"
		default n

	config FREETZ_PACKAGE_DEJAVU_FONTS_TTF_DejaVuSerif_Italic
		bool "DejaVuSerif-Italic"
		default n

	config FREETZ_PACKAGE_DEJAVU_FONTS_TTF_DejaVuSerif
		bool "DejaVuSerif"
		default n

endif # FREETZ_PACKAGE_DEJAVU_FONTS_TTF
```

## Backups/freetz-ng/make/pkgs/fontconfig/Config.in
```kconfig
config FREETZ_PACKAGE_FONTCONFIG
	bool "Fontconfig 2.14.2 (binary only)"
	depends on FREETZ_LIB_libfontconfig
	default n
	help
		Fontconfig is a library for configuring and customizing
		font access. This package adds /etc/fontsfonts.conf
```

## Backups/freetz-ng/make/pkgs/ftdi1/Config.in
```kconfig
config FREETZ_PACKAGE_FTDI1
	bool "ftdi1 1.5"
	depends on ! (FREETZ_TARGET_UCLIBC_0_9_28 || FREETZ_TARGET_UCLIBC_0_9_29)
	select FREETZ_LIB_libusb_1
	select FREETZ_LIB_libftdi1
	select FREETZ_LIB_libconfuse
	default n
	help
		ftdi_eeprom of libftdi1
		is a small tool for reading/erasing/flashing FTDI USB chip eeproms.
		It uses libftdi1 to access the chip, so you will need to have the
		required permissions on the device. The ftdi_sio module should not
		be loaded. You have to unplug and replug your device to get the new
		values to be read. Otherwise, you will still get the old values.
```

## Backups/freetz-ng/make/pkgs/iconv/Config.in
```kconfig
config FREETZ_PACKAGE_ICONV
	bool "iconv 1.13.1 (binary only)"
	depends on FREETZ_TARGET_UCLIBC_0_9_28
	select FREETZ_LIB_libiconv
	default n
	help
		A program for converting text from one encoding to another.
```

## Backups/freetz-ng/make/pkgs/iperf/Config.in
```kconfig
config FREETZ_PACKAGE_IPERF
	bool "iPerf3 3.3/3.15 (binary only)"
	default n
	help
		iPerf3 is a tool for active measurements of the maximum achievable
		bandwidth on IP networks. It supports tuning of various parameters
		related to timing, buffers and protocols (TCP, UDP, SCTP with IPv4
		and IPv6). For each test it reports the bandwidth, loss, and other
		parameters. S. https://github.com/esnet/iperf for more details.

if FREETZ_PACKAGE_IPERF

	choice
		prompt "Version"
			default FREETZ_PACKAGE_IPERF_VERSION_CURRENT

		config FREETZ_PACKAGE_IPERF_VERSION_ABANDON
			bool "3.3"
			depends on !FREETZ_TARGET_IPV6_SUPPORT || (FREETZ_TARGET_UCLIBC_0_9_28 || FREETZ_TARGET_UCLIBC_0_9_29)
			help
				Version 3.3 is the last with IPv4-only support.
				Also this version is compatible with old uClibc.

		config FREETZ_PACKAGE_IPERF_VERSION_CURRENT
			bool "3.15"
			depends on FREETZ_TARGET_IPV6_SUPPORT && !(FREETZ_TARGET_UCLIBC_0_9_28 || FREETZ_TARGET_UCLIBC_0_9_29)

	endchoice

	config FREETZ_PACKAGE_IPERF_WITH_OPENSSL
		bool "build with SSL support"
		select FREETZ_LIB_libcrypto if !FREETZ_PACKAGE_IPERF_STATIC
		default n
		help
			This option enables OpenSSL support in iperf.

		config FREETZ_PACKAGE_IPERF_STATIC
			bool "Link statically"
			depends on FREETZ_PACKAGE_IPERF_WITH_OPENSSL

endif # FREETZ_PACKAGE_IPERF
```

## Backups/freetz-ng/make/pkgs/pcsc-lite/Config.in
```kconfig
config FREETZ_PACKAGE_PCSC_LITE
	bool "PCSC-lite 1.9.5/2.0.1 (binary only)"
	select FREETZ_LIB_libdl       if FREETZ_TARGET_UCLIBC_HAS_multiple_libs
	select FREETZ_LIB_libpthread  if FREETZ_TARGET_UCLIBC_HAS_multiple_libs
	select FREETZ_LIB_librt       if FREETZ_TARGET_UCLIBC_HAS_multiple_libs
	select FREETZ_LIB_libusb_1
	select FREETZ_LIB_libpcsclite # loaded per dlopen
	default n
	help
		The purpose of PCSC Lite is to provide a Windows(R)
		SCard interface in a very small form factor for
		communicating to smart cards and readers.

if FREETZ_PACKAGE_PCSC_LITE

	choice
		prompt "Version"
			default FREETZ_PACKAGE_PCSC_LITE_VERSION_CURRENT

		config FREETZ_PACKAGE_PCSC_LITE_VERSION_ABANDON
			bool "1.9.5"
			depends on FREETZ_LIB_libusb_1_WITH_ABANDON
			help
				The C11 atomics are available since GCC v4.9 only.

		config FREETZ_PACKAGE_PCSC_LITE_VERSION_CURRENT
			bool "2.0.1"
			depends on !FREETZ_LIB_libusb_1_WITH_ABANDON

	endchoice

endif # FREETZ_PACKAGE_PCSC_LITE
```

## Backups/freetz-ng/make/pkgs/proxychains-ng/Config.in
```kconfig
config FREETZ_PACKAGE_PROXYCHAINS_NG
	bool "ProxyChains-NG 4.17"
	select FREETZ_LIB_libpthread if FREETZ_TARGET_UCLIBC_HAS_multiple_libs
	default n
	help
		A preloader which hooks calls to sockets in dynamically
		linked programs and redirects it through one or more
		socks/http proxies, tor is also supported.

		Usage: proxychains4 telnet mail.example.com 25

if FREETZ_PACKAGE_PROXYCHAINS_NG

	config FREETZ_PACKAGE_PROXYCHAINS_NG_SELECT_TOR
		bool "Select Tor"
		depends on FREETZ_OPENSSL_VERSION_1_MIN
		select FREETZ_PACKAGE_TOR
		default n

endif # FREETZ_PACKAGE_PROXYCHAINS_NG
```

## Backups/freetz-ng/make/pkgs/psl/Config.in
```kconfig
config FREETZ_PACKAGE_PSL
	bool "psl 0.21.2 (binary only)"
	select FREETZ_LIB_libpsl
	default n
	help
		Public Suffix List library functions
		This includes psl binary and public_suffix_list.dat
```

## Backups/freetz-ng/make/pkgs/rrdtool/Config.in
```kconfig
config FREETZ_PACKAGE_RRDTOOL
	bool "RRDtool 1.2.30/1.8.0 (binary only)"
	select FREETZ_LIB_librrd
	select FREETZ_LIB_libm                                 if FREETZ_TARGET_UCLIBC_HAS_multiple_libs
	select FREETZ_LIB_libz                                 if FREETZ_PACKAGE_RRDTOOL_VERSION_ABANDON
	select FREETZ_PACKAGE_DEJAVU_FONTS_TTF                 if FREETZ_PACKAGE_RRDTOOL_VERSION_CURRENT
	select FREETZ_PACKAGE_DEJAVU_FONTS_TTF_DejaVuSansMono  if FREETZ_PACKAGE_RRDTOOL_VERSION_CURRENT
	default n
	help
		RRDtool is the OpenSource industry standard, high
		performance data logging and graphing system for
		time series data. Use it to write your custom
		monitoring shell scripts or create whole applications
		using its PHP bindings.

if FREETZ_PACKAGE_RRDTOOL

	choice
		prompt "Version"
			default FREETZ_PACKAGE_RRDTOOL_VERSION_ABANDON

		config FREETZ_PACKAGE_RRDTOOL_VERSION_ABANDON
			bool "1.2.30"
			help
				This version needs about 0,7MB (including all libs).

		config FREETZ_PACKAGE_RRDTOOL_VERSION_CURRENT
			bool "1.8.0"
			depends on FREETZ_SEPARATE_AVM_UCLIBC
			help
				This version needs about 3,7MB (including all libs).

	endchoice

endif # FREETZ_PACKAGE_RRDTOOL
```

## Backups/freetz-ng/make/pkgs/strace/Config.in
```kconfig
config FREETZ_PACKAGE_STRACE
	bool "strace 4.9/5.0/6.7 (binary only)"
	default n
	help
		strace - trace system calls and signals

		strace is a system call tracer, i.e. a debugging tool which prints out
		a trace of all the system calls made by a another process/program.

if FREETZ_PACKAGE_STRACE

	choice
		prompt "Version"

		config FREETZ_PACKAGE_STRACE_VERSION_4
			bool "4.9"
			depends on  (                                FREETZ_KERNEL_VERSION_2_6_13)

		config FREETZ_PACKAGE_STRACE_VERSION_5
			bool "5.0"
			depends on  (FREETZ_KERNEL_VERSION_2_MAX && !FREETZ_KERNEL_VERSION_2_6_13)

		config FREETZ_PACKAGE_STRACE_VERSION_6
			bool "6.7"
			depends on !(FREETZ_KERNEL_VERSION_2_MAX                                 )

	endchoice

endif # FREETZ_PACKAGE_STRACE
```

## Backups/freetz-ng/make/pkgs/transmission-cgi/Config.in
```kconfig
config FREETZ_PACKAGE_TRANSMISSION_CGI
	bool "Transmission CGI"
	depends on FREETZ_PACKAGE_TRANSMISSION_DAEMON
	select FREETZ_BUSYBOX_START_STOP_DAEMON
	default n
	help
		Provides a simple configuration interface
		for transmission-daemon.
```
