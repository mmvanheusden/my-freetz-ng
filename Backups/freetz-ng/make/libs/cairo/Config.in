## Backups/freetz-ng/make/pkgs/tree/Config.in
```kconfig
config FREETZ_PACKAGE_TREE
	bool "Tree 1.8.0/2.1.1 (binary only)"
	default n
	help
		Tree is a recursive directory listing program
		that produces a depth indented listing of files,
		which is colorized ala dircolors if the LS_COLORS
		environment variable is set and output is to tty.

if FREETZ_PACKAGE_TREE

	choice
		prompt "Version"
			default FREETZ_PACKAGE_TREE_VERSION_CURRENT

		config FREETZ_PACKAGE_TREE_VERSION_ABANDON
			bool "1.8.0"
			depends on  (FREETZ_TARGET_UCLIBC_0_9_28 || FREETZ_TARGET_UCLIBC_0_9_29)

		config FREETZ_PACKAGE_TREE_VERSION_CURRENT
			bool "2.1.1"
			depends on !(FREETZ_TARGET_UCLIBC_0_9_28 || FREETZ_TARGET_UCLIBC_0_9_29)

	endchoice

endif # FREETZ_PACKAGE_TREE
```

## Backups/freetz-ng/make/pkgs/vnstat/Config.in
```kconfig
config FREETZ_PACKAGE_VNSTAT
	bool "vnStat 1.18 (binary only)"
	default n
	select FREETZ_LIB_libm if FREETZ_TARGET_UCLIBC_HAS_multiple_libs
	help
		vnStat is a console-based network traffic monitor. It keeps a log of
		hourly, daily and monthly network traffic for the selected interface(s).
		However, it isn't a packet sniffer. The traffic information is analyzed
		from the proc(5) filesystem. That way vnStat can be used even
		without root permissions.

if FREETZ_PACKAGE_VNSTAT

	config FREETZ_PACKAGE_VNSTAT_DAEMON
		bool "vnstat daemon"
		default n
		help
			This is a daemon for collection data

	config FREETZ_PACKAGE_VNSTAT_IMAGE
		bool "vnstat image"
		default n
		select FREETZ_LIB_libgd
		help
			This component is for creating images

endif # FREETZ_PACKAGE_VNSTAT
```
